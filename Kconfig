## Kconfig
```kconfig
menu "Camera Configuration"

    choice CAMERA_BOARD

        prompt "Camera Board"
        default CAMERA_BOARD_XIAO_ESP32_S3_SENSE

        config CAMERA_BOARD_XIAO_ESP32_S3_SENSE
            bool "XIAO ESP32-S3 Sense"

        config CAMERA_BOARD_FREENOVE_ESP32_S3_WROOM1
            bool "Freenove ESP32-S3 WROOM1"

    endchoice

    config CAMERA_FB_COUNT
        int "Camera framebuffer count"
        default 2
        range 1 4

    config CAMERA_XCLK_FREQ
        int "Camera XCLK frequency"
        default 20000000

    menu "Camera Image Control"

        config CAMERA_AUTO_WHITE_BALANCE
            bool "Enable automatic white balance"
            default y
        
        choice CAMERA_WHITE_BALANCE_MODE
            prompt "Manual white balance"
            default CAMERA_WB_SUNNY
            depends on !CAMERA_AUTO_WHITE_BALANCE
        
            config CAMERA_WB_SUNNY
                bool "Sunny"
            
            config CAMERA_WB_CLOUDY
                bool "Cloudy"
            
            config CAMERA_WB_OFFICE
                bool "Office"
            
            config CAMERA_WB_HOME
                bool "Home"
            
        endchoice
            
            
        config CAMERA_AUTO_EXPOSURE
            bool "Enable automatic exposure"
            default y
        
        config CAMERA_EXPOSURE_VALUE
            int "Manual exposure value" if !CAMERA_AUTO_EXPOSURE
            default 200
            range 0 1200
        
        
        config CAMERA_AUTO_GAIN
            bool "Enable automatic gain"
            default y
        
        config CAMERA_GAIN
            int "Manual gain" if !CAMERA_AUTO_GAIN
            default 0
            range 0 64
        
    endmenu

    choice CAMERA_FRAME_SIZE
        prompt "Camera frame size"
        default CAMERA_FRAME_SIZE_QVGA

        config CAMERA_FRAME_SIZE_QQVGA
            bool "QQVGA (160x120)"

        config CAMERA_FRAME_SIZE_QVGA
            bool "QVGA (320x240)"

        config CAMERA_FRAME_SIZE_VGA
            bool "VGA (640x480)"

    endchoice

endmenu
```
